## boards/shields/dactyl/Kconfig.defconfig
```kconfig
if SHIELD_DACTYL_LEFT

    config ZMK_KEYBOARD_NAME
        default "Dactyl"
endif

if SHIELD_DACTYL_RIGHT

    config ZMK_KEYBOARD_NAME
        default "Dactyl Right"

    config ZMK_SPLIT_BLE_ROLE_CENTRAL
        default y

    # Battery level fetching disabled in dactyl.conf for freeze investigation
    # config ZMK_SPLIT_BLE_CENTRAL_BATTERY_LEVEL_FETCHING
    #     default y
    # config ZMK_SPLIT_BLE_CENTRAL_BATTERY_LEVEL_PROXY
    #     default y

endif

if SHIELD_DACTYL_LEFT || SHIELD_DACTYL_RIGHT

    config ZMK_SPLIT
        default y

endif
```

## config/boards/shields/dactyl/Kconfig.defconfig
```kconfig
if SHIELD_DACTYL_LEFT

    config ZMK_KEYBOARD_NAME
        default "Dactyl"

    config ZMK_SPLIT_BLE_ROLE_CENTRAL
        default y
endif

if SHIELD_DACTYL_RIGHT

    config ZMK_KEYBOARD_NAME
        default "Dactyl Right"

endif

if SHIELD_DACTYL_LEFT || SHIELD_DACTYL_RIGHT

    config ZMK_SPLIT
        default y

endif
```

## config/west.yml
```yaml
manifest:
  remotes:
    - name: zmkfirmware
      url-base: https://github.com/zmkfirmware
    - name: rdaniel0
      url-base: https://github.com/rdaniel0
  projects:
    - name: zmk
      remote: rdaniel0
      revision: fix/combo-long-max
      import: app/west.yml
  self:
    path: config
```
