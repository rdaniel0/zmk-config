// dactyl_left.overlay

#include "dactyl.dtsi" // Notice that the main dtsi files are included in the overlay.

&kscan0 {
    col-gpios
        = <&gpio0 11 GPIO_ACTIVE_HIGH> // col0
        , <&gpio1 0  GPIO_ACTIVE_HIGH> // col1
        , <&gpio0 24 GPIO_ACTIVE_HIGH> // col2
        , <&gpio0 22 GPIO_ACTIVE_HIGH> // col3
        , <&gpio0 20 GPIO_ACTIVE_HIGH> // col4
        ;
};