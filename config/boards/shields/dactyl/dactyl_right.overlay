// dactyl_right.overlay

#include "dactyl.dtsi" // Notice that the main dtsi files are included in the overlay.

// The matrix transform for this board is 5 columns over because the left half is 5 columns wide according to the matrix.
&default_transform {
    col-offset = <5>;
};

&kscan0 {
    col-gpios
        = <&gpio0 20 GPIO_ACTIVE_HIGH> // col9
        , <&gpio0 22 GPIO_ACTIVE_HIGH> // col8
        , <&gpio0 24 GPIO_ACTIVE_HIGH> // col7
        , <&gpio1 0  GPIO_ACTIVE_HIGH> // col6
        , <&gpio0 11 GPIO_ACTIVE_HIGH> // col5
        ;
};